## meta-aurora/conf/layer.conf
```bitbake
BBPATH .= ":${LAYERDIR}"
BBFILES += "${LAYERDIR}/recipes*/*/*.bb ${LAYERDIR}/recipes*/*/*.bbappend"
BBFILE_COLLECTIONS += "aurora-hybris-layer"
BBFILE_PATTERN_aurora-hybris-layer := "^${LAYERDIR}/"
BBFILE_PRIORITY_aurora-hybris-layer = "7"
LAYERSERIES_COMPAT_aurora-hybris-layer = "kirkstone"
```

## meta-r11/conf/layer.conf
```bitbake
BBPATH .= ":${LAYERDIR}"
BBFILES += "${LAYERDIR}/recipes*/*/*.bb ${LAYERDIR}/recipes*/*/*.bbappend"
BBFILE_COLLECTIONS += "r11-hybris-layer"
BBFILE_PATTERN_r11-hybris-layer := "^${LAYERDIR}/"
BBFILE_PRIORITY_r11-hybris-layer = "7"
LAYERSERIES_COMPAT_r11-hybris-layer = "kirkstone"
```

## meta-r11/conf/machine/r11.conf
```bitbake
#@TYPE: Machine
#@NAME: Google Pixel Watch (LTE)
#@DESCRIPTION: Machine configuration for the Google Pixel Watch (LTE)

# note that the duplicate inclusion of tune-cortexa53.inc and
# tune-cortexa7.inc causes warnings, since both ultimately include
# many of the same files.  That's okay, it's an OE bug.
require conf/machine/include/arm/armv8a/tune-cortexa53.inc
require conf/machine/include/arm/armv7a/tune-cortexa7.inc
require conf/machine/include/hybris-watch.inc

MACHINE_DISPLAY_ROUND = "true"
MACHINE_NEEDS_BURN_IN_PROTECTION = "false"
MACHINE_HAS_WLAN = "true"
MACHINE_HAS_SPEAKER = "true"

PREFERRED_PROVIDER_virtual/android-system-image = "android"
PREFERRED_VERSION_android = "pie"

PREFERRED_PROVIDER_virtual/kernel = "linux-r11"
PREFERRED_VERSION_linux = "4.4+pie"

DEFAULTTUNE = "armv7vehf-neon"
TARGET_ARCH = "arm"
TUNE_ARCH ??= "cortexa7"
TUNE_AVAIL += "cortexa7 cortexa53"
TUNE_PKGARCH = "armv7vehf-neon"
TUNE_FEATURES ??= "${TUNE_FEATURES:tune-cortexa7hf-neon-vfpv4}"

KERNEL_IMAGETYPE = "Image"

IMAGE_INSTALL += "android-system-data"
```
